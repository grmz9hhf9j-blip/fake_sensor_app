## CMakeLists.txt
```
cmake_minimum_required(VERSION 3.28.0)

find_package(Zephyr REQUIRED HINTS $ENV{ZEPHYR_BASE})
project(fake_sensor_app)

target_sources(app PRIVATE
    ${CMAKE_CURRENT_SOURCE_DIR}/src/main.c
    ${CMAKE_CURRENT_SOURCE_DIR}/src/ringbuf.c
)

target_include_directories(app PRIVATE
    ${CMAKE_CURRENT_SOURCE_DIR}/src
)
```

## west.yml
```
manifest:
  remotes:
    - name: zephyrproject-rtos
      url-base: https://github.com/zephyrproject-rtos
  projects:
    - name: zephyr
      remote: zephyrproject-rtos
      revision: v4.4.2
      import: true
    - name: sensor_xyz
      url: https://github.com/grmz9hhf9j-blip/fake_accel_sensor
      revision: main
      path: modules/sensor_xyz
  self:
    path: app
  
```

## prj.conf
```kconfig
CONFIG_SENSOR=y
CONFIG_SENSOR_XYZ=y
CONFIG_SENSOR_XYZ_RATE_HZ=100

CONFIG_SYS_CLOCK_TICKS_PER_SEC=16000
CONFIG_HEAP_MEM_POOL_SIZE=16384

CONFIG_PRINTK=y
CONFIG_CBPRINTF_FP_SUPPORT=y
CONFIG_CBPRINTF_NANO=n

CONFIG_ZTEST=n

CONFIG_SHELL=y
CONFIG_SHELL_BACKEND_SERIAL=y
```

## boards/native_sim.overlay
```dts
/ {
	aliases {
		accel0 = &xyz0;
	};

	xyz0: accel {
		compatible = "sensor,xyz";
		status = "okay";
		label = "FAKE_XYZ";
		odr-hz = <100>;
	};
};
```

## src/main.c
```c
#include <stdint.h>

#include <zephyr/kernel.h>
#include <zephyr/sys/util.h>
#include <zephyr/device.h>
#include <zephyr/drivers/sensor.h>
#include <zephyr/sys/printk.h>
#include <zephyr/sys/atomic.h>
#include <zephyr/devicetree.h>

#include <errno.h>
#include <zephyr/shell/shell.h>
#include <zephyr/shell/shell_uart.h>

#include "ringbuf.h"
#include <string.h>

// #define MATCH_OUTPUT_RATE
#define APP_SENSOR_NODE DT_ALIAS(accel0)

#ifdef MATCH_OUTPUT_RATE
#define APP_SAMPLE_RATE_HZ DT_PROP(APP_SENSOR_NODE, odr_hz)
#else
#define APP_SAMPLE_RATE_HZ 100U
#endif

#define APP_SAMPLE_RATE_HZ 100U
#define APP_SAMPLE_PERIOD K_USEC(1000000U / APP_SAMPLE_RATE_HZ)
#define APP_DRAIN_PERIOD K_MSEC(50)
#define APP_DRAIN_MAX 20U
#define APP_CONSUMER_STACK_SIZE 4096
#define APP_CONSUMER_PRIORITY 7

static atomic_t stream_enabled = ATOMIC_INIT(1);

static const struct device *const sensor =
	DEVICE_DT_GET(APP_SENSOR_NODE);

static ringbuf_t *sample_buffer;
static atomic_t dropped_samples;
static atomic_t sensor_errors;

static atomic_t dump_requested;

K_SEM_DEFINE(consumer_wake, 0, 1);

static int cmd_samples_stream(const struct shell *sh,
							  size_t argc, char **argv)
{
	ARG_UNUSED(argc);

	if (strcmp(argv[1], "on") == 0)
	{
		atomic_set(&stream_enabled, 1);
	}
	else if (strcmp(argv[1], "off") == 0)
	{
		atomic_set(&stream_enabled, 0);
	}
	else
	{
		shell_error(sh, "Use: samples stream on|off");
		return -EINVAL;
	}

	shell_print(sh, "Streaming %s", argv[1]);

	return 0;
}

static void sensor_work_handler(struct k_work *work)
{
	struct sensor_value axes[3];
	struct accel_sample sample;
	int ret;

	ARG_UNUSED(work);

	ret = sensor_sample_fetch(sensor);
	if (ret != 0)
	{
		atomic_inc(&sensor_errors);
		return;
	}

	sample.t_ms = k_uptime_get();

	ret = sensor_channel_get(sensor, SENSOR_CHAN_ACCEL_XYZ, axes);
	if (ret != 0)
	{
		atomic_inc(&sensor_errors);
		return;
	}

	sample.ax_ms2 = sensor_value_to_float(&axes[0]);
	sample.ay_ms2 = sensor_value_to_float(&axes[1]);
	sample.az_ms2 = sensor_value_to_float(&axes[2]);

	if (!rb_push(sample_buffer, &sample))
	{
		atomic_inc(&dropped_samples);
	}
}
K_WORK_DEFINE(sensor_work, sensor_work_handler);

static void sample_timer_handler(struct k_timer *timer)
{
	ARG_UNUSED(timer);

	k_work_submit(&sensor_work);
}
K_TIMER_DEFINE(sample_timer, sample_timer_handler, NULL);

static void drain_timer_handler(struct k_timer *timer)
{
	ARG_UNUSED(timer);

	k_sem_give(&consumer_wake);
}

K_TIMER_DEFINE(drain_timer, drain_timer_handler, NULL);

static void consumer_entry(void *p1, void *p2, void *p3)
{
	const struct shell *sh = shell_backend_uart_get_ptr();
	struct accel_sample batch[APP_DRAIN_MAX];
	uint64_t consumed = 0;
	int64_t last_stats_ms = k_uptime_get();

	ARG_UNUSED(p1);
	ARG_UNUSED(p2);
	ARG_UNUSED(p3);

	while (true)
	{
		k_sem_take(&consumer_wake, K_FOREVER);

		bool requested = atomic_set(&dump_requested, 0) != 0;
		size_t count = rb_drain(sample_buffer, batch,
								ARRAY_SIZE(batch));
		bool streaming = atomic_get(&stream_enabled) != 0;
		if (requested)
		{
			shell_print(sh, "{\"type\":\"dump\",\"count\":%u}",
						(unsigned int)count);
		}

		for (size_t i = 0; i < count && (streaming || requested); ++i)
		{
			const struct accel_sample *sample = &batch[i];

			shell_print(sh,
						"{\"t_ms\":%lld,\"ax_ms2\":%.6f,"
						"\"ay_ms2\":%.6f,\"az_ms2\":%.6f}",
						(long long)sample->t_ms,
						(double)sample->ax_ms2,
						(double)sample->ay_ms2,
						(double)sample->az_ms2);
		}

		consumed += count;

		int64_t now_ms = k_uptime_get();

		if (streaming && now_ms - last_stats_ms >= 1000)
		{
			shell_print(sh,
						"{\"type\":\"stats\",\"consumed\":%llu,"
						"\"queued\":%u,\"dropped\":%ld,"
						"\"sensor_errors\":%ld}",
						(unsigned long long)consumed,
						(unsigned int)rb_size(sample_buffer),
						(long)atomic_get(&dropped_samples),
						(long)atomic_get(&sensor_errors));

			last_stats_ms = now_ms;
		}
	}
}

K_THREAD_DEFINE(consumer_thread, APP_CONSUMER_STACK_SIZE,
				consumer_entry, NULL, NULL, NULL,
				APP_CONSUMER_PRIORITY, 0, SYS_FOREVER_MS);

static int cmd_samples_dump(const struct shell *sh,
							size_t argc, char **argv)
{
	ARG_UNUSED(argc);
	ARG_UNUSED(argv);

	if (!atomic_cas(&dump_requested, 0, 1))
	{
		shell_error(sh, "A dump is already pending");
		return -EBUSY;
	}

	k_sem_give(&consumer_wake);

	return 0;
}

SHELL_STATIC_SUBCMD_SET_CREATE(
	samples_commands,
	SHELL_CMD_ARG(dump, NULL, "Dump up to 20 queued samples",
				  cmd_samples_dump, 1, 0),
	SHELL_CMD_ARG(stream, NULL, "Enable or disable automatic output",
				  cmd_samples_stream, 2, 0),
	SHELL_SUBCMD_SET_END);

SHELL_CMD_REGISTER(samples, &samples_commands, "Sample commands", NULL);

int main(void)
{
	if (!device_is_ready(sensor))
	{
		printk("Sensor not ready\n");
		return 1;
	}

	sample_buffer = rb_create(RB_CAPACITY);
	if (sample_buffer == NULL)
	{
		printk("Ring buffer allocation failed\n");
		return 1;
	}

	k_timer_start(&sample_timer, APP_SAMPLE_PERIOD, APP_SAMPLE_PERIOD);
	k_timer_start(&drain_timer, APP_DRAIN_PERIOD, APP_DRAIN_PERIOD);
	k_thread_start(consumer_thread);

	return 0;
}
```

## src/ringbuf.c
```c
#include "ringbuf.h"

#include <limits.h>

#include <zephyr/kernel.h>
#include <zephyr/sys/atomic.h>

struct ringbuf {
	atomic_t write_index;
	atomic_t read_index;
	size_t slots;
	struct accel_sample samples[];
};

static size_t rb_next(const ringbuf_t *rb, size_t index)
{
	++index;

	return index == rb->slots ? 0 : index;
}

ringbuf_t *rb_create(size_t capacity)
{
	ringbuf_t *rb;
	size_t slots;
	size_t bytes;

	if (capacity == 0 || capacity > INT_MAX) {
		return NULL;
	}

	slots = capacity + 1;

	if (slots > (SIZE_MAX - sizeof(*rb)) /
		    sizeof(struct accel_sample)) {
		return NULL;
	}

	bytes = sizeof(*rb) + slots * sizeof(struct accel_sample);
	rb = k_malloc(bytes);

	if (rb == NULL) {
		return NULL;
	}

	atomic_set(&rb->write_index, 0);
	atomic_set(&rb->read_index, 0);
	rb->slots = slots;

	return rb;
}

void rb_destroy(ringbuf_t *rb)
{
	k_free(rb);
}

bool rb_push(ringbuf_t *rb, const struct accel_sample *sample)
{
	size_t write_index;
	size_t next;

	if (rb == NULL || sample == NULL) {
		return false;
	}

	write_index = (size_t)atomic_get(&rb->write_index);
	next = rb_next(rb, write_index);

	if (next == (size_t)atomic_get(&rb->read_index)) {
		return false;
	}

	rb->samples[write_index] = *sample;
	atomic_set(&rb->write_index, (atomic_val_t)next);

	return true;
}

bool rb_pop(ringbuf_t *rb, struct accel_sample *out)
{
	size_t read_index;

	if (rb == NULL || out == NULL) {
		return false;
	}

	read_index = (size_t)atomic_get(&rb->read_index);

	if (read_index == (size_t)atomic_get(&rb->write_index)) {
		return false;
	}

	*out = rb->samples[read_index];
	atomic_set(&rb->read_index,
		   (atomic_val_t)rb_next(rb, read_index));

	return true;
}

size_t rb_size(const ringbuf_t *rb)
{
	size_t read_index;
	size_t write_index;

	if (rb == NULL) {
		return 0;
	}

	read_index = (size_t)atomic_get(&rb->read_index);
	write_index = (size_t)atomic_get(&rb->write_index);

	if (write_index >= read_index) {
		return write_index - read_index;
	}

	return rb->slots - read_index + write_index;
}

size_t rb_capacity(const ringbuf_t *rb)
{
	return rb == NULL ? 0 : rb->slots - 1;
}

size_t rb_drain(ringbuf_t *rb, struct accel_sample *dst, size_t max)
{
	size_t count = 0;

	if (rb == NULL || dst == NULL) {
		return 0;
	}

	while (count < max && rb_pop(rb, &dst[count])) {
		++count;
	}

	return count;
}
```

## src/ringbuf.h
```c
#ifndef RINGBUF_H
#define RINGBUF_H


#include <stdbool.h>
#include <stddef.h>
#include <stdint.h>

#define RB_CAPACITY 256

struct accel_sample {
	int64_t t_ms;
	float ax_ms2;
	float ay_ms2;
	float az_ms2;
};

typedef struct ringbuf ringbuf_t;

ringbuf_t *rb_create(size_t capacity);
void rb_destroy(ringbuf_t *rb);

bool rb_push(ringbuf_t *rb, const struct accel_sample *sample);
bool rb_pop(ringbuf_t *rb, struct accel_sample *out);

size_t rb_size(const ringbuf_t *rb);
size_t rb_capacity(const ringbuf_t *rb);

size_t rb_drain(ringbuf_t *rb, struct accel_sample *dst, size_t max);

#endif // RINGBUF_H
```
