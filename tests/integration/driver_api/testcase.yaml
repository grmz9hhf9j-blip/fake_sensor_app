## tests/integration/driver_api/testcase.yaml
```yaml
tests:
  app.driver_api:
    platform_allow:
      - native_sim
    integration_platforms:
      - native_sim
    harness: ztest
    tags:
      - sensor
      - integration
    timeout: 30
```

## tests/unit/ringbuf/testcase.yaml
```yaml
tests:
  app.ringbuf:
    platform_allow:
      - native_sim
    integration_platforms:
      - native_sim
    harness: ztest
    tags:
      - ringbuf
    timeout: 30
```

## west.yml
```yaml
manifest:
  remotes:
    - name: zephyrproject-rtos
      url-base: https://github.com/zephyrproject-rtos
  projects:
    - name: zephyr
      remote: zephyrproject-rtos
      revision: v4.4.2
      path: deps/zephyr
      import: true
    - name: sensor_xyz
      url: https://github.com/grmz9hhf9j-blip/fake_accel_sensor
      revision: 0b6939c53a96c68fc10faf1bdd2c89fb384a369c
      path: modules/sensor_xyz
  self:
    path: .
  
```
